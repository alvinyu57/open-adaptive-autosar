AUTOSAR XML (schema 00051)
package /MachineManifest
  machine WSL_VM_Machine: machine-design=WSL_VM_Design
    os module instantiation Ubuntu_OS
      resource group DefaultGroup
    processor CPU0
      core Core0: core-id=0
    function-groups:
      mode declaration group prototype MachineFG: type=MachineStates
    processes:
      process HelloWorldProcess: executable=HelloWorldProcessExecutable
    ethernet communication connector Eth0Connector
      unicast network endpoint Eth0Endpoint: network-endpoint-addresses=ipv-4-configuration={ipv-4-address=192.168.0.100, ipv-4-netmask=255.255.255.0}
  mode declaration group MachineStates: initial-mode=Startup
    4 x mode:
      Startup
      Running
      Restart
      Shutdown
