AUTOSAR XML (schema 00054)
package /Machines
  machine ExampleMachine: default-application-timeout={enter-timeout-value=5, exit-timeout-value=5}, machine-design=ExampleMachineDesign, trusted-platform-executable-launch-behavior=STRICT-MODE
    os module instantiation LinuxOS
      resource group SystemResourceGroup
package /FunctionGroupSets
  function group set MachineFGSet
    function-groups:
      mode declaration group prototype MachineFG: type=MachineStates
package /ModeDeclarationGroups
  mode declaration group MachineStates: initial-mode=Startup
    5 x mode:
      Off
      Startup
      Running
      Shutdown
      Verify
