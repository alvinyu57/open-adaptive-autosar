AUTOSAR XML (schema 00054)
package /Executables
  executable openaa_example_hello_world_runner: reporting-behavior=REPORTS-EXECUTION-STATE, version=1.0.0
package /Processes
  process HelloWorldProcess: executable=openaa_example_hello_world_runner, number-of-restart-attempts=1, pre-mapping=false, state-dependent-startup-config{function-group-state=MachineFG.Running, startup-config=HelloWorldStartupConfig}
    process state machine HelloWorldProcessStateMachine: type=MachineStates
package /StartupConfigs
  startup config HelloWorldStartupConfig: environment-variables=tag-with-optional-value={key=OPENAA_EXAMPLE_PROFILE, value=hello_world}, permission-to-create-child-process=false, process-argument=--sample-mode=adaptive, scheduling-policy=SCHEDULING-POLICY-FIFO, scheduling-priority=15, termination-behavior=PROCESS-IS-SELF-TERMINATING, timeout={enter-timeout-value=5, exit-timeout-value=5}
