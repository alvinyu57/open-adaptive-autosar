AUTOSAR XML (schema 00051)
package /HelloWorldExecutionManifest
  executable HelloWorldProcessExecutable: reporting-behavior=REPORTS-EXECUTION-STATE
  process HelloWorldProcess: executable=HelloWorldProcessExecutable, state-dependent-startup-config{function-group-state=MachineFG.Startup, startup-config=HelloWorldStartupConfig}
  startup config HelloWorldStartupConfig: termination-behavior=processIsSelfTerminating
