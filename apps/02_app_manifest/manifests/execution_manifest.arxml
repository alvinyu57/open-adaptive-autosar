AUTOSAR XML (schema 4.0)
package /OpenAA/Execution
  execution manifest ExecManifestDemo: process-name=app_manifest_demo_process, application=/OpenAA/Applications/AppManifestDemo, startup-configuration={auto-start=true, startup-order=10}, state-dependency={function-group=MachineFG, function-group-state=Startup}, termination-behavior={termination-timeout-ms=2000, restart-attempts=3}
