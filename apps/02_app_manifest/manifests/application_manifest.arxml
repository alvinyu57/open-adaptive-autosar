AUTOSAR XML (schema 4.0)
package /OpenAA/Applications
  application manifest AppManifestDemo: application-id=apps.02_app_manifest.demo, executable-name=openaa_app_manifest_demo, arguments=--mode=demo, environment-variable{name=OPENAA_APP_PROFILE, value=app_manifest_demo}, provided-service{service-id=apps.02.app_manifest.greeter, endpoint=local://app-manifest-greeter}
