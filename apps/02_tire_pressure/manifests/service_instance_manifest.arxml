AUTOSAR XML (schema 00054)
package /ServiceInterfaceDeployments
  user defined service interface deployment TirePressureServiceDeployment: service-interface=TirePressureServiceInterface
    user defined event deployment TirePressureEventDeployment: event=TirePressureEvent
    user defined method deployment GetLatestPressureDeployment: method=GetLatestPressure
    user defined method deployment LowPressureAlarmDeployment: method=LowPressureAlarm
package /ServiceInstances
  provided user defined service instance TirePressureProvidedInstance: service-interface-deployment=TirePressureServiceDeployment
  required user defined service instance TirePressureRequiredInstance: service-interface-deployment=TirePressureServiceDeployment
