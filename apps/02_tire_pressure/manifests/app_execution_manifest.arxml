AUTOSAR XML (schema 00054)
package /Executables
  executable openaa_tire_pressure_provider: reporting-behavior=REPORTS-EXECUTION-STATE, version=1.0.0
  executable openaa_tire_pressure_consumer: reporting-behavior=REPORTS-EXECUTION-STATE, version=1.0.0
package /Processes
  process TirePressureProviderProcess: executable=openaa_tire_pressure_provider, number-of-restart-attempts=1, pre-mapping=false, state-dependent-startup-config{function-group-state=MachineFG.Running, startup-config=TirePressureProviderStartupConfig}
    process state machine TirePressureProviderStateMachine: type=MachineStates
  process TirePressureConsumerProcess: executable=openaa_tire_pressure_consumer, number-of-restart-attempts=1, pre-mapping=false, state-dependent-startup-config{function-group-state=MachineFG.Running, startup-config=TirePressureConsumerStartupConfig}
    process state machine TirePressureConsumerStateMachine: type=MachineStates
package /StartupConfigs
  startup config TirePressureProviderStartupConfig: environment-variables=tag-with-optional-value={key=OPENAA_EXAMPLE_PROFILE, value=tire_pressure_provider}, permission-to-create-child-process=false, process-argument=--role=provider, scheduling-policy=SCHEDULING-POLICY-FIFO, scheduling-priority=15, termination-behavior=PROCESS-IS-SELF-TERMINATING, timeout={enter-timeout-value=5, exit-timeout-value=5}
  startup config TirePressureConsumerStartupConfig: environment-variables=tag-with-optional-value={key=OPENAA_EXAMPLE_PROFILE, value=tire_pressure_consumer}, permission-to-create-child-process=false, process-argument=--role=consumer, scheduling-policy=SCHEDULING-POLICY-FIFO, scheduling-priority=15, termination-behavior=PROCESS-IS-SELF-TERMINATING, timeout={enter-timeout-value=5, exit-timeout-value=5}
